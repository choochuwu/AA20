## Kconfig.defconfig
```kconfig
# Copyright (c) 2020 The ZMK Contributors
# SPDX-License-Identifier: MIT

if SHIELD_AA20

config ZMK_KEYBOARD_NAME
    default "AA20"

endif
```

## Kconfig.shield
```kconfig
# Copyright (c) 2020 The ZMK Contributors
# SPDX-License-Identifier: MIT

config SHIELD_AA20
   def_bool $(shields_list_contains,aa20)
```
